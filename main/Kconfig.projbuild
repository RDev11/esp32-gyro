## main/Kconfig.projbuild
```kconfig
menu "Example Configuration"

    config BLINK_GPIO
        int "Blink GPIO number"
        range 0 48
        default 8 if IDF_TARGET_ESP32C3 || IDF_TARGET_ESP32H2
        default 18 if IDF_TARGET_ESP32S2
        default 48 if IDF_TARGET_ESP32S3
        default 5
        help
            GPIO number (IOxx) to blink on and off or the RMT signal for the addressable LED.
            Some GPIOs are used for other purposes (flash connections, etc.) and cannot be used to blink.

    config BUTTON_GPIO
        int "Button GPIO number"
        range 0 48
        default 4
        help
            GPIO number Button.

    config PIN_NUM_MOSI
        int "MOSI pin"
        range 0 48
        default 23
        help
            MOSI (SDI) pin. Master Output Slave Input

    config PIN_NUM_MISO
        int "MISO pin"
        range 0 48
        default 19
        help
            MISO (SDO) pin. Master Input Slave Output

    config PIN_NUM_CLK
        int "CLK pin"
        range 0 48
        default 18
        help
            SCLK: SCK, CLK, SPC (SPI serial port clock) pin.

    config PIN_NUM_CS_DISPLAY
        int "CS pin"
        range 0 48
        default 5
        help
            CS (SS,NCS) pin. - Chip Select

    config PIN_NUM_DCRS
        int "DC/RS pin"
        range 0 48
        default 14
        help
            Display DC/RS pin.

    config PIN_NUM_CS_GYRO
        int "CS pin"
        range 0 48
        default 25
        help
            CS (SS,NCS) pin. - Chip Select

    config PIN_NUM_MOT1_DIR
        int "PIN_NUM_MOT1_DIR"
        range 0 48
        default 27
        help
            PIN_NUM_MOT1_DIR.

    config PIN_NUM_MOT1_STEP
        int "PIN_NUM_MOT1_STEP"
        range 0 48
        default 26
        help
            Display DC/RS pin.

    config PIN_NUM_MOT2_DIR
        int "PIN_NUM_MOT2_DIR"
        range 0 48
        default 33
        help
            PIN_NUM_MOT2_DIR.

    config PIN_NUM_MOT2_STEP
        int "PIN_NUM_MOT2_STEP"
        range 0 48
        default 32
        help
            PIN_NUM_MOT2_STEP.
endmenu
```
